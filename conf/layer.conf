## conf/layer.conf
```bitbake
# We have a conf and classes directory, append to BBPATH
BBPATH .= ":${LAYERDIR}"

# We have a recipes directory, add to BBFILES
BBFILES += "${LAYERDIR}/recipes*/*/*.bb ${LAYERDIR}/recipes*/*/*.bbappend"

BBFILE_COLLECTIONS += "liveimage-init"
BBFILE_PATTERN_liveimage-init := "^${LAYERDIR}/"
BBFILE_PRIORITY_liveimage-init = "6"

LAYERSERIES_COMPAT_liveimage-init = "sumo"
```
